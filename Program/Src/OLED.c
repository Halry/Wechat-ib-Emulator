#include "OLED.h"
bool OLED_SPI_DMA_Busy=false;
extern DMA_HandleTypeDef hdma_spi2_tx;
uint8_t *Reverse_temp=NULL;
uint32_t OLED_SPI_Tick=0;
bool OLED_Ready=false;
const uint8_t F6x8[][6]=
{
  0x00, 0x00, 0x00, 0x00, 0x00, 0x00,// sp
  0x00, 0x00, 0x00, 0x2f, 0x00, 0x00,// !
  0x00, 0x00, 0x07, 0x00, 0x07, 0x00,// "
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  0x14, 0x14, 0x14, 0x14, 0x14, 0x14,// horiz lines
};
const uint8_t F8X16[]=
{
  0x00,0x00,0x00,0x00,0x00,0x00,0x00,0x00,0x00,0x00,0x00,0x00,0x00,0x00,0x00,0x00,// 0
  0x00,0x00,0x00,0xF8,0x00,0x00,0x00,0x00,0x00,0x00,0x00,0x33,0x30,0x00,0x00,0x00,//! 1
  0x00,0x10,0x0C,0x06,0x10,0x0C,0x06,0x00,0x00,0x00,0x00,0x00,0x00,0x00,0x00,0x00,//" 2
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  0x00,0x06,0x01,0x01,0x02,0x02,0x04,0x04,0x00,0x00,0x00,0x00,0x00,0x00,0x00,0x00,//~ 94
};
extern SPI_HandleTypeDef hspi2;
void OLED_DrawBMP(uint8_t x0, uint8_t y0,uint8_t x1, uint8_t y1,const uint8_t* BMP)
{
  unsigned int j=0;
  unsigned char x,y;
  if(y1%8==0) y=y1/8;
  else y=y1/8+1;
  for(y=y0; y<y1; y++)
    {
    OLED_Set_Pos(x0,y);
    for(x=x0; x<x1; x++)
      {
      OLED_WR_Byte(BMP[j++],OLED_DATA_FLAG);
      }
    }
}
void OLED_WR_Byte(uint8_t data,bool cmd_flag)
{
  while(OLED_SPI_DMA_Busy==true)
    {
    if(HAL_GetTick()-OLED_SPI_Tick>=1000)
      {
      OLED_SPI_DMA_Busy=false;
      }
    }
  OLED_SPI_DMA_Busy=true;
  if(cmd_flag)
    OLED_DC_SET();
  else
    OLED_DC_CLR();
  HAL_SPI_Transmit_DMA(&hspi2,&data,1);
  OLED_SPI_Tick=HAL_GetTick();
  OLED_DC_SET();
}
void OLED_WR_R_Byte(uint8_t data,bool cmd_flag)
{
  while(OLED_SPI_DMA_Busy==true)
    {
    if(HAL_GetTick()-OLED_SPI_Tick>=1000)
      {
      OLED_SPI_DMA_Busy=false;
      }
    }
  OLED_SPI_DMA_Busy=true;
  uint8_t i;
  i=~data;
  if(cmd_flag)
    OLED_DC_SET();
  else
    OLED_DC_CLR();
  HAL_SPI_Transmit_DMA(&hspi2,&i,1);
  OLED_SPI_Tick=HAL_GetTick();
  OLED_DC_SET();
}
void OLED_WR_Data(uint8_t *data,uint16_t size)
{
  while(OLED_SPI_DMA_Busy==true)
    {
    if(HAL_GetTick()-OLED_SPI_Tick>=1000)
      {
      OLED_SPI_DMA_Busy=false;
      }
    }
  OLED_DC_CLR();
  HAL_SPI_Transmit_DMA(&hspi2,data,size);
  OLED_SPI_DMA_Busy=true;
  OLED_SPI_Tick=HAL_GetTick();
  OLED_DC_SET();
}
void OLED_WR_R_Data(uint8_t *data,uint16_t size)
{
  while(OLED_SPI_DMA_Busy==true)
    {
    if(HAL_GetTick()-OLED_SPI_Tick>=1000)
      {
      OLED_SPI_DMA_Busy=false;
      }
    }
  Reverse_temp=malloc(size);
  for(uint16_t c=0; c<size; c++)
    {
    *(Reverse_temp+c)=~(*(data+c));
    }
  OLED_DC_CLR();
  HAL_SPI_Transmit_DMA(&hspi2,Reverse_temp,size);
  OLED_SPI_DMA_Busy=true;
  OLED_SPI_Tick=HAL_GetTick();
  OLED_DC_SET();
}
void OLED_ShowChar(uint8_t x,uint8_t y,uint8_t chr,bool Large_Font)
{
  unsigned char c=0;
  c=chr-' ';//???????
  if(x>Max_Column-1)
    {
    x=0;
    y=y+2;
    }
  if(Large_Font==true)
    {
    OLED_Set_Pos(x,y);
    OLED_WR_Data((uint8_t *)&F8X16[c*16],8);
    OLED_Set_Pos(x,y+1);
    OLED_WR_Data((uint8_t *)&F8X16[c*16+8],8);
    }
  else
    {
    OLED_Set_Pos(x,y);
    OLED_WR_Data((uint8_t *)&F6x8[c][0],6);
    }
}
void OLED_R_ShowChar(uint8_t x,uint8_t y,uint8_t chr,bool Large_Font)
{
  unsigned char c=0,i=0;
  c=chr-' ';//???????
  if(x>Max_Column-1)
    {
    x=0;
    y=y+2;
    }
  if(Large_Font==true)
    {
    OLED_Set_Pos(x,y);
    for(i=0; i<8; i++)
      OLED_WR_R_Byte(F8X16[c*16+i],OLED_DATA_FLAG);
    OLED_Set_Pos(x,y+1);
    for(i=0; i<8; i++)
      OLED_WR_R_Byte(F8X16[c*16+i+8],OLED_DATA_FLAG);
    }
  else
    {
    OLED_Set_Pos(x,y);
    for(i=0; i<6; i++)
      OLED_WR_R_Byte(F6x8[c][i],OLED_DATA_FLAG);
    }
}
void OLED_ShowString(uint8_t x,uint8_t y,const uint8_t *chr,bool Large_Font)
{
  unsigned char j=0;
  while(chr[j]!='\0')
    {
    OLED_ShowChar(x,y,chr[j],Large_Font);
    if(Large_Font==true)
      {
      x+=8;
      }
    else
      {
      x+=6;
      }
    if(x>120)
      {
      x=0;
      y+=2;
      }
    j++;
    }
}
void OLED_R_ShowString(uint8_t x,uint8_t y,const uint8_t *chr,bool Large_Font)
{
  unsigned char j=0;
  while(chr[j]!='\0')
    {
    OLED_R_ShowChar(x,y,chr[j],Large_Font);
    if(Large_Font==true)
      {
      x+=8;
      }
    else
      {
      x+=6;
      }
    if(x>120)
      {
      x=0;
      y+=2;
      }
    j++;
    }
}
void OLED_ShowChinese(uint8_t x,uint8_t y,const uint8_t *chinese)
{
  uint8_t addr=16;
  for(uint8_t c=0; c<=chinese[0]; c++)
    {
    OLED_Set_Pos(x+(c*16),y);
    OLED_WR_Data((uint8_t *)(chinese+addr),16);
    addr+=16;
    OLED_Set_Pos(x+(c*16),y+1);
    OLED_WR_Data((uint8_t *)(chinese+addr),16);
    addr+=16;
    }
}
void OLED_R_ShowChinese(uint8_t x,uint8_t y,const uint8_t *chinese)
{
  uint8_t addr=16;
  for(uint8_t c=0; c<=chinese[0]; c++)
    {
    OLED_Set_Pos(x+(c*16),y);
    OLED_WR_R_Data((uint8_t *)(chinese+addr),16);
    addr+=16;
    OLED_Set_Pos(x+(c*16),y+1);
    OLED_WR_R_Data((uint8_t *)(chinese+addr),16);
    addr+=16;
    }
}

void OLED_Init(void)
{
  HAL_GPIO_WritePin(GPIOB, GPIO_PIN_1, GPIO_PIN_SET);
  OLED_SPI_Ctrl(true);
  OLED_RST_SET();
  HAL_Delay(100);
  OLED_RST_CLR();
  HAL_Delay(100);
  OLED_RST_SET();
  //Reset the OLED Panel
  OLED_WR_Byte(0xAE,OLED_CMD_FLAG);
  OLED_WR_Byte(0x00,OLED_CMD_FLAG);//---set low column address
  OLED_WR_Byte(0x10,OLED_CMD_FLAG);//---set high column address
  OLED_WR_Byte(0x40,OLED_CMD_FLAG);//--set start line address  Set Mapping RAM Display Start Line (0x00~0x3F)
  OLED_WR_Byte(0x81,OLED_CMD_FLAG);//--set contrast control register
  OLED_WR_Byte(0xCF,OLED_CMD_FLAG); // Set SEG Output Current Brightness
  OLED_WR_Byte(0xA1,OLED_CMD_FLAG);//--Set SEG/Column Mapping     0xa0 0xa1
  OLED_WR_Byte(0xC8,OLED_CMD_FLAG);//Set COM/Row Scan Direction   0xc0 0xc8
  OLED_WR_Byte(0xA6,OLED_CMD_FLAG);//--set normal display
  OLED_WR_Byte(0xA8,OLED_CMD_FLAG);//--set multiplex ratio(1 to 64)
  OLED_WR_Byte(0x3f,OLED_CMD_FLAG);//--1/64 duty
  OLED_WR_Byte(0xD3,OLED_CMD_FLAG);//-set display offset	Shift Mapping RAM Counter (0x00~0x3F)
  OLED_WR_Byte(0x00,OLED_CMD_FLAG);//-not offset
  OLED_WR_Byte(0xd5,OLED_CMD_FLAG);//--set display clock divide ratio/oscillator frequency
  OLED_WR_Byte(0x80,OLED_CMD_FLAG);//--set divide ratio, Set Clock as 100 Frames/Sec
  OLED_WR_Byte(0xD9,OLED_CMD_FLAG);//--set pre-charge period
  OLED_WR_Byte(0xF1,OLED_CMD_FLAG);//Set Pre-Charge as 15 Clocks & Discharge as 1 Clock
  OLED_WR_Byte(0xDA,OLED_CMD_FLAG);//--set com pins hardware configuration
  OLED_WR_Byte(0x12,OLED_CMD_FLAG);
  OLED_WR_Byte(0xDB,OLED_CMD_FLAG);//--set vcomh
  OLED_WR_Byte(0x40,OLED_CMD_FLAG);//Set VCOM Deselect Level
  OLED_WR_Byte(0x20,OLED_CMD_FLAG);//-Set Page Addressing Mode (0x00/0x01/0x02)
  OLED_WR_Byte(0x02,OLED_CMD_FLAG);//
  OLED_WR_Byte(0x8D,OLED_CMD_FLAG);//--set Charge Pump enable/disable
  OLED_WR_Byte(0x14,OLED_CMD_FLAG);//--set(0x10) disable
  OLED_WR_Byte(0xA4,OLED_CMD_FLAG);// Disable Entire Display On (0xa4/0xa5)
  OLED_WR_Byte(0xA6,OLED_CMD_FLAG);// Disable Inverse Display On (0xa6/a7)
  OLED_WR_Byte(0xAF,OLED_CMD_FLAG);//--turn on oled panel
  OLED_WR_Byte(0xAF,OLED_CMD_FLAG); /*display ON*/
  OLED_Clear();
  OLED_Set_Pos(0,0);
  OLED_Ready=true;
}
void OLED_Set_Pos(uint8_t x, uint8_t y)
{
  OLED_WR_Byte(0xb0+y,OLED_CMD_FLAG);
  OLED_WR_Byte(((x&0xf0)>>4)|0x10,OLED_CMD_FLAG);
  OLED_WR_Byte((x&0x0f)|0x01,OLED_CMD_FLAG);
}
void OLED_Clear(void)
{
  uint8_t i,n;
  for(i=0; i<8; i++)
    {
    OLED_WR_Byte(0xb0+i,OLED_CMD_FLAG);
    OLED_WR_Byte(0x00,OLED_CMD_FLAG);
    OLED_WR_Byte(0x10,OLED_CMD_FLAG);
    for(n=0; n<128; n++)OLED_WR_Byte(0,OLED_DATA_FLAG);
    }
}
void OLED_PowerOff()
{
  OLED_Ready=false;
  HAL_GPIO_WritePin(GPIOB, GPIO_PIN_1, GPIO_PIN_RESET);
  OLED_SPI_Ctrl(false);
}
void OLED_SPI_Ctrl(bool enabled)
{
  if(enabled==true)
    {
    hspi2.Instance = SPI2;
    hspi2.Init.Mode = SPI_MODE_MASTER;
    hspi2.Init.Direction = SPI_DIRECTION_1LINE;
    hspi2.Init.DataSize = SPI_DATASIZE_8BIT;
    hspi2.Init.CLKPolarity = SPI_POLARITY_LOW;
    hspi2.Init.CLKPhase = SPI_PHASE_1EDGE;
    hspi2.Init.NSS = SPI_NSS_HARD_OUTPUT;
    hspi2.Init.BaudRatePrescaler = SPI_BAUDRATEPRESCALER_256;
    hspi2.Init.FirstBit = SPI_FIRSTBIT_MSB;
    hspi2.Init.TIMode = SPI_TIMODE_DISABLE;
    hspi2.Init.CRCCalculation = SPI_CRCCALCULATION_DISABLE;
    hspi2.Init.CRCPolynomial = 10;
    if(HAL_SPI_Init(&hspi2) != HAL_OK)
      {
      _Error_Handler(__FILE__, __LINE__);
      }
    }
  else
    {
    if(HAL_SPI_DeInit(&hspi2) != HAL_OK)
      {
      _Error_Handler(__FILE__, __LINE__);
      }
    }
}
void HAL_SPI_TxCpltCallback(SPI_HandleTypeDef *hspi)
{
  if(hspi->Instance==SPI2)
    OLED_SPI_DMA_Busy=false;
  OLED_DC_SET();
  if(Reverse_temp!=NULL)
    {
    free(Reverse_temp);
    }
}